VERSION ""

NS_ :

BS_:

BU_: CAN2S CAN2M CAN1

BO_ 17 CAN2S_ADC_Msg: 2 CAN2S
 SG_ CAN2S_ADC_Sig : 0|12@1+ (1,0) [0|0] "mV" Vector__XXX

BO_ 16 CAN2M_ADC_Msg: 2 CAN2M
 SG_ CAN2M_ADC_Sig : 0|12@1+ (1,0) [0|0] "mV" Vector__XXX

BO_ 9 CAN1_ADC_Msg: 2 CAN1
 SG_ CAN1_ADC_Sig : 0|12@1+ (1,0) [0|0] "mV" Vector__XXX

BO_ 82 CAN2S_Act_Msg: 1 CAN2S
 SG_ CAN2S_Act_Sig : 0|1@1+ (1,0) [0|0] "" Vector__XXX

BO_ 81 CAN2M_Act_Msg: 1 CAN2M
 SG_ CAN2M_Act_Sig : 0|1@1+ (1,0) [0|0] "" Vector__XXX

BO_ 80 CAN1_Act_Msg: 1 CAN1
 SG_ CAN1_Act_Sig : 0|1@1+ (1,0) [0|0] "" Vector__XXX

BO_ 258 CAN2S_Pres_Msg: 1 CAN2S
 SG_ CAN2S_Pres_Sig : 0|1@1+ (1,0) [0|0] "" Vector__XXX

BO_ 33 CAN2M_Pres_Msg: 1 CAN2M
 SG_ CAN2M_Pres_Sig : 0|1@1+ (1,0) [0|0] "" Vector__XXX

BO_ 32 CAN1_Pres_Msg: 1 CAN1
 SG_ CAN1_Pres_Sig : 0|1@1+ (1,0) [0|0] "" Vector__XXX
